# file: Veliki_nucleo_konacno.ioc
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Mcu.Family=STM32F4
Mcu.Name=STM32F401R(D-E)Tx
Mcu.Package=LQFP64
NVIC.PriorityGroup=NVIC_PRIORITYGROUP_4
PA13.Mode=Serial_Wire
PA13.Signal=SYS_JTMS-SWDIO
PA14.Mode=Serial_Wire
PA14.Signal=SYS_JTCK-SWCLK
PH0\ -\ OSC_IN.Mode=HSE-External-Oscillator
PH0\ -\ OSC_IN.Signal=RCC_OSC_IN
PH1\ -\ OSC_OUT.Mode=HSE-External-Oscillator
PH1\ -\ OSC_OUT.Signal=RCC_OSC_OUT
ProjectManager.HeapSize=0x200
ProjectManager.StackSize=0x400
ProjectManager.TargetToolchain=STM32CubeIDE
RCC.48MHZClocksFreq_Value=42000000
RCC.AHBFreq_Value=84000000
RCC.APB1CLKDivider=RCC_HCLK_DIV2
RCC.APB1Freq_Value=42000000
RCC.APB1TimFreq_Value=84000000
RCC.APB2Freq_Value=84000000
RCC.APB2TimFreq_Value=84000000
RCC.CortexFreq_Value=84000000
RCC.HCLKFreq_Value=84000000
RCC.HSE_VALUE=25000000
RCC.HSI_VALUE=16000000
RCC.LSE_VALUE=32768
RCC.PLLM=8
RCC.PLLN=84
RCC.SYSCLKFreq_VALUE=84000000
RCC.SYSCLKSource=RCC_SYSCLKSOURCE_PLLCLK
RCC.VCOOutputFreq_Value=168000000
board=custom

// file: Core/Src/main.c
/* USER CODE BEGIN Header */
/**
 ******************************************************************************
 * @file           : main.c
 * @brief          : Main program body
 ******************************************************************************
 * @attention
 *
 * <h2><center>&copy; Copyright (c) 2023 STMicroelectronics.
 * All rights reserved.</center></h2>
 *
 * This software component is licensed by ST under BSD 3-Clause license,
 * the "License"; You may not use this file except in compliance with the
 * License. You may obtain a copy of the License at:
 *                        opensource.org/licenses/BSD-3-Clause
 *
 ******************************************************************************
 */
/* USER CODE END Header */

#include "main.h"

/* USER CODE BEGIN Includes */
bool promenljiva1;
bool promenljiva2;
bool promenljiva3;
bool promenljiva4;
bool promenljiva5;

/* USER CODE END Includes */

void SystemClock_Config(void);
static void MX_GPIO_Init(void);

int main(void) {

	/* MCU Configuration--------------------------------------------------------*/

	/* Reset of all peripherals, Initializes the Flash interface and the Systick. */
	HAL_Init();

	/* USER CODE BEGIN Init */
	gpio_init();
	sick_init();
	tajmer_init();
	uart_init();
	step_init();
	maxxoni_init();
	odometrija_init();
	pid_init();
	enkoder_init();
	/* USER CODE END Init */

	/* Configure the system clock */
	SystemClock_Config();

	/* Initialize all configured peripherals */
	MX_GPIO_Init();
	/* Infinite loop */
	/* USER CODE BEGIN WHILE */
	//motor1_smer(true);
	//motor2_smer(true);
	while (1) {

		// okretanje_m1(15);
		// okretanje_m2(15);
		//if (promenljiva1 == true)
		// {
		//	  okretanje_m1(0);
		//	  okretanje_m2(0);
		// }

		/*
		 zatvaranje_zadnjh_vrata();
		 loptice_pocetni_polozaj();
		 tajmer_delay(1000);
		 otvaranje_zadnjh_vrata();
		 prva_loptica();
		 tajmer_delay(1000);
		 zatvaranje_zadnjh_vrata();
		 druga_loptica();
		 tajmer_delay(1000);
		 zatvaranje_zadnjh_vrata();
		 treca_loptica();
		 tajmer_delay(1000);
		 */
		/*
		 zatvaranje_zadnjh_vrata();
		 loptice_pocetni_polozaj();
		 tajmer_delay(1000);
		 otvaranje_zadnjh_vrata();
		 tajmer_delay(1000);
		 prva_loptica();
		 tajmer_delay(1000);
		 otvaranje_zadnjh_vrata();
		 druga_loptica();
		 otvaranje_zadnjh_vrata();
		 tajmer_delay(1000);
		 treca_loptica();
		 tajmer_delay(1000);

		 servo_control(6, 200);
		 prednja_desna_vrata_hvatanje();
		 prednja_leva_vrata_hvatanje();
		 tajmer_delay(2000);
		 prednja_desna_vrata_otvorena();
		 prednja_leva_vrata_otvorena();
		 servo_control(6, 240);
		 tajmer_delay(2000);

		 steper_suprotan_ugao();
		 tajmer_delay(2000);
		 steper_pun_ugao();
		 tajmer_delay(2000);
		 */
		//SIKOVE
		promenljiva1 = sickLB();
		promenljiva2 = sickLF();
		promenljiva3 = sickRB();
		promenljiva4 = sickRF();
		promenljiva5 = sickMID();

		//STEPPER
		/*
		 steper_suprotan_ugao();
		 tajmer_delay(2000);
		 steper_pun_ugao();
		 tajmer_delay(2000);
		 */
		//CINC
		/*
		 bool pomocna = cinc_stanje();
		 if (pomocna == true)
		 {
		 gpio_led_stanje(true);
		 }
		 else
		 {
		 gpio_led_stanje(false);
		 }
		 */

	}
	/* USER CODE END 3 */
}

void SystemClock_Config(void) {
	RCC_OscInitTypeDef RCC_OscInitStruct = { 0 };
	RCC_ClkInitTypeDef RCC_ClkInitStruct = { 0 };

	/** Configure the main internal regulator output voltage
	 */
	__HAL_RCC_PWR_CLK_ENABLE();
	__HAL_PWR_VOLTAGESCALING_CONFIG(PWR_REGULATOR_VOLTAGE_SCALE2);
	/** Initializes the CPU, AHB and APB busses clocks
	 */
	RCC_OscInitStruct.OscillatorType = RCC_OSCILLATORTYPE_HSI;
	RCC_OscInitStruct.HSIState = RCC_HSI_ON;
	RCC_OscInitStruct.HSICalibrationValue = RCC_HSICALIBRATION_DEFAULT;
	RCC_OscInitStruct.PLL.PLLState = RCC_PLL_ON;
	RCC_OscInitStruct.PLL.PLLSource = RCC_PLLSOURCE_HSI;
	RCC_OscInitStruct.PLL.PLLM = 8;
	RCC_OscInitStruct.PLL.PLLN = 84;
	RCC_OscInitStruct.PLL.PLLP = RCC_PLLP_DIV2;
	RCC_OscInitStruct.PLL.PLLQ = 4;
	if (HAL_RCC_OscConfig(&RCC_OscInitStruct) != HAL_OK) {
		Error_Handler();
	}
	/** Initializes the CPU, AHB and APB busses clocks
	 */
	RCC_ClkInitStruct.ClockType = RCC_CLOCKTYPE_HCLK | RCC_CLOCKTYPE_SYSCLK
			| RCC_CLOCKTYPE_PCLK1 | RCC_CLOCKTYPE_PCLK2;
	RCC_ClkInitStruct.SYSCLKSource = RCC_SYSCLKSOURCE_PLLCLK;
	RCC_ClkInitStruct.AHBCLKDivider = RCC_SYSCLK_DIV1;
	RCC_ClkInitStruct.APB1CLKDivider = RCC_HCLK_DIV2;
	RCC_ClkInitStruct.APB2CLKDivider = RCC_HCLK_DIV1;

	if (HAL_RCC_ClockConfig(&RCC_ClkInitStruct, FLASH_LATENCY_2) != HAL_OK) {
		Error_Handler();
	}
}

static void MX_GPIO_Init(void) {

	/* GPIO Ports Clock Enable */
	__HAL_RCC_GPIOH_CLK_ENABLE();
	__HAL_RCC_GPIOA_CLK_ENABLE();

}

void Error_Handler(void) {
}

/************************ (C) COPYRIGHT STMicroelectronics *****END OF FILE****/
